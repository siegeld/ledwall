# colorlight register map
Vendor: litex
Registers are 32-bit, read-write, reset 0x0 unless marked. A register's access mark holds for its fields unless they carry their own. Offsets are from the block's base; [hi:lo] are bit positions; <NAME> marks a mode.

## ETHMAC
Base 0xF0003000
0x00 SRAM_WRITER_SLOT
  [0] sram_writer_slot
0x04 SRAM_WRITER_LENGTH
  [10:0] sram_writer_length
0x08 SRAM_WRITER_ERRORS
0x0C SRAM_WRITER_EV_STATUS — This register contains the current raw level of the available event trigger. Writes to this register have no effect.
  [0] available — Level of the ``available`` event
0x10 SRAM_WRITER_EV_PENDING — When a available event occurs, the corresponding bit will be set in this register. To clear the Event, set the corresponding bit in this register.
  [0] available — `1` if a `available` event occurred. This Event is **level triggered** when the signal is **high**.
0x14 SRAM_WRITER_EV_ENABLE — This register enables the corresponding available events. Write a ``0`` to this register to disable individual events.
  [0] available — Write a ``1`` to enable the ``available`` Event
0x18 SRAM_READER_START
  [0] sram_reader_start
0x1C SRAM_READER_READY
  [0] sram_reader_ready
0x20 SRAM_READER_LEVEL
  [1:0] sram_reader_level
0x24 SRAM_READER_SLOT
  [0] sram_reader_slot
0x28 SRAM_READER_LENGTH
  [10:0] sram_reader_length
0x2C SRAM_READER_EV_STATUS — This register contains the current raw level of the event0 event trigger. Writes to this register have no effect.
  [0] event0 — Level of the ``event0`` event
0x30 SRAM_READER_EV_PENDING — When a event0 event occurs, the corresponding bit will be set in this register. To clear the Event, set the corresponding bit in this register.
  [0] event0 — `1` if a this particular event occurred. This Event is triggered on a **rising** edge.
0x34 SRAM_READER_EV_ENABLE — This register enables the corresponding event0 events. Write a ``0`` to this register to disable individual events.
  [0] event0 — Write a ``1`` to enable the ``event0`` Event
0x38 PREAMBLE_CRC reset 0x1
  [0] preamble_crc
0x3C RX_DATAPATH_PREAMBLE_ERRORS
0x40 RX_DATAPATH_CRC_ERRORS
0x44 IP_ADDRESS reset 0xA0B06FA
0x48 MAC_ADDRESS1 reset 0x10E2 — Bits 32-47 of `ETHMAC_MAC_ADDRESS`. The value won't take effect until `ETHMAC_MAC_ADDRESS0` is written.
  [31:0] mac_address
0x4C MAC_ADDRESS0 reset 0xD5000001 — Bits 0-31 of `ETHMAC_MAC_ADDRESS`. Writing this register triggers an update of `ETHMAC_MAC_ADDRESS`.
  [31:0] mac_address
0x50 PIXEL_FILTER_ENABLE — Kill UDP pixel packets before the CPU's MAC sees them
  [0] pixel_filter_enable
0x54 PIXEL_FILTER_PORT reset 0x1B58 — UDP destination port the CPU filter kills
  [15:0] pixel_filter_port
0x58 PIXEL_FILTER_KILLED — Packets killed on the CPU branch
0x5C DBG_MAC1 — Bits 32-47 of `ETHMAC_DBG_MAC`. Last parsed destination MAC
  [31:0] dbg_mac
0x60 DBG_MAC0 — Bits 0-31 of `ETHMAC_DBG_MAC`.
  [31:0] dbg_mac
0x64 DBG_ETHERTYPE — Last parsed ethertype
  [15:0] dbg_ethertype
0x68 C_CORE — Beats out of the MAC core
0x6C C_SPLIT2 — Beats into the hardware branch
0x70 C_GATE_OUT — Beats out of the gate
0x74 C_NARROW_OUT — Beats out of the 32->8 converter
0x78 C_DROPPED — Packets dropped by the gate
0x7C C_GROUP — Group-addressed frames rejected before burst_fifo
0x80 C_FIFO_MAX — Deepest burst_fifo level since the last c_fifo_clear
  [15:0] c_fifo_max
0x84 C_FIFO_CLEAR — Write 1 to reset c_fifo_max, so it reads as a window rather than a lifetime mark
  [0] c_fifo_clear
0x88 CPU_STALL_MAX — Longest run of cycles the MAC was held because the CPU RX path (SRAM slots) was not ready. Since c_fifo_clear.
  [15:0] cpu_stall_max
0x8C CPU_STALL_CYCLES — Total cycles the CPU RX path held the MAC. Lifetime.
0x90 ARRIVE_RUN_MAX — Longest run of back-to-back packets (gap < 64 cycles) at the gate input. Since c_fifo_clear.
  [7:0] arrive_run_max
0x94 DRAIN_STALL_MAX — Longest run of cycles burst_fifo held data its consumer would not take. Since c_fifo_clear.
  [15:0] drain_stall_max
0x98 N_GATE — Packets leaving the always-ready gate
0x9C N_NARROW — Packets leaving the 32->8 converter
0xA0 N_MAC — Packets passing the MAC filter
0xA4 N_IP — Packets passing the IP filter
0xA8 N_UDP — Payloads passing the UDP port filter
